/**
 * @cliArgs --device "F2838x" --package "337bga" --part "F2838x_337bga" --product "C2000WARE@3.01.00.00"
 * @versions {"tool":"1.13.0+2553"}
 */

/**
 * Import the modules used in this configuration.
 */
const adc   = scripting.addModule("/driverlib/adc.js", {}, false);
const adc1  = adc.addInstance();
const adc2  = adc.addInstance();
const gpio  = scripting.addModule("/driverlib/gpio.js", {}, false);
const gpio1 = gpio.addInstance();

/**
 * Write custom configuration values to the imported modules.
 */
adc1.$name               = "myADC0";
adc1.adcClockPrescaler   = "ADC_CLK_DIV_4_0";
adc1.enabledSOCs         = ["ADC_SOC_NUMBER0","ADC_SOC_NUMBER1"];
adc1.soc1Channel         = "ADC_CH_ADCIN1";
adc1.soc0SampleWindow    = 15;
adc1.soc1SampleWindow    = 15;
adc1.enabledInts         = ["ADC_INT_NUMBER1"];
adc1.interruptPulseMode  = "ADC_PULSE_END_OF_CONV";
adc1.enableInterrupt1    = true;
adc1.interrupt1SOCSource = "ADC_SOC_NUMBER1";

adc2.$name               = "myADC1";
adc2.adcBase             = "ADCC_BASE";
adc2.adcClockPrescaler   = "ADC_CLK_DIV_4_0";
adc2.enabledSOCs         = ["ADC_SOC_NUMBER0","ADC_SOC_NUMBER1"];
adc2.soc0SampleWindow    = 15;
adc2.soc1SampleWindow    = 15;
adc2.soc1Channel         = "ADC_CH_ADCIN3";
adc2.soc0Channel         = "ADC_CH_ADCIN2";
adc2.enabledInts         = ["ADC_INT_NUMBER1"];
adc2.interruptPulseMode  = "ADC_PULSE_END_OF_CONV";
adc2.enableInterrupt1    = true;
adc2.interrupt1SOCSource = "ADC_SOC_NUMBER1";

gpio1.$name = "myGPIO0";

/**
 * Pinmux solution for unlocked pins/peripherals. This ensures that minor changes to the automatic solver in a future
 * version of the tool will not impact the pinmux you originally saw.  These lines can be completely deleted in order to
 * re-solve from scratch.
 */
gpio1.gpioPin.$suggestSolution = "ball.C8";
